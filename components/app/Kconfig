## components/app/Kconfig
```kconfig
menu "App"
    config APP_LED_GPIO
        int "LED GPIO (-1 = disabled)"
        default 1
        range -1 48
    config APP_LED_ACTIVE_LOW
        bool "LED active low"
        default y
endmenu
```

## components/board/Kconfig
```kconfig
menu "Board" 
    config BOARD_I2C
        bool "Enable I2C"
        default y
    config BOARD_SPI1
        bool "Enable spi1"
        default n
    config BOARD_SPI2
        bool "Enable spi2"
        default y
    config BOARD_I2S
        bool "Enable i2s"
        default y

    config BOARD_LED1
        int "Red led"
        default 1
    config BOARD_KEY
        bool "Enable key"
        default y
    config BOARD_LCD
        bool "Enable lcd"
        depends on BOARD_SPI2
        default y
    config BOARD_AUDIO_ES8388
        bool "Enable es8388"
        depends on BOARD_I2S && BOARD_I2C
        default y
    config BOARD_XL9555
        bool "Enable xl9555"
        default y
    
    config BOARD_I2C_SCL
        int "I2C SCL GPIO"
        depends on BOARD_I2C
        default 42
    config BOARD_I2C_SDA
        int "I2C SDA GPIO"
        depends on BOARD_I2C
        default 41

    config BOARD_XL9555_ADDR
        hex "XL9555 I2C address"
        depends on BOARD_I2C && BOARD_XL9555
        default 0x20

    config BOARD_XL9555_LCD_PWR_BIT
        int "XL9555 bit: LCD power"
        depends on BOARD_XL9555
        default 11

    config BOARD_XL9555_LCD_RST_BIT
        int "XL9555 bit: LCD reset"
        depends on BOARD_XL9555
        default 10

    config BOARD_XL9555_LCD_BL_BIT
        int "XL9555 bit: LCD backlight"
        depends on BOARD_XL9555
        default 8

    config BOARD_LCD_SCK
        int "LCD SPI SCK GPIO"
        depends on BOARD_SPI2
        default 12

    config BOARD_LCD_MOSI
        int "LCD SPI MOSI GPIO"
        depends on BOARD_SPI2
        default 11

    config BOARD_LCD_CS
        int "LCD SPI CS GPIO"
        default 21

    config BOARD_LCD_DC
        int "LCD SPI DC GPIO"
        depends on BOARD_SPI2
        default 40

    config BOARD_KEY_GPIO
        int "Boot key GPIO"
        depends on BOARD_KEY
        default 5
    
    config BOARD_ES8388_I2S_MCLK
        int "Es8388 i2s mclk"
        depends on BOARD_AUDIO_ES8388
        default 3
    config BOARD_ES8388_I2S_SCK
        int "Es8388 i2s sck"
        depends on BOARD_AUDIO_ES8388
        default 46
    config BOARD_ES8388_I2S_LRCK
        int "Es8388 i2s lrck"
        depends on BOARD_AUDIO_ES8388
        default 9
    config BOARD_ES8388_I2S_SDIN
        int "Es8388 i2s sdin"
        depends on BOARD_AUDIO_ES8388
        default 10
    config BOARD_ES8388_I2S_SDOUT
        int "Es8388 i2s sdout"
        depends on BOARD_AUDIO_ES8388
        default 14
    config BOARD_ES8388_I2C_SCL
        int "Es8388 i2c scl"
        depends on BOARD_AUDIO_ES8388
        default 42
    config BOARD_ES8388_I2C_SDA
        int "Es8388 i2c sda"
        depends on BOARD_AUDIO_ES8388
        default 41
endmenu
```
